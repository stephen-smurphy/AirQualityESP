## main/Kconfig.projbuild
```kconfig
menu "Wi-Fi Configuration"

config WIFI_SSID
    string "WiFi SSID"
    default ""

config WIFI_PASSWORD
    string "WiFi Password"
    default ""

config MQTT_URI
    string "MQTT URI"
    default ""

config MQTT_USERNAME
    string "MQTT Username"
    default ""

config MQTT_PASSWORD
    string "MQTT Password"
    default ""

endmenu

menu "OTA Configuration"

config OTA_UPDATE_FIRMWARE_URL
    string "OTA Update Firmware URL"
    default ""

config OTA_UPDATE_VERSION_URL
    string "OTA Update Version URL"
    default ""

endmenu
```
